## CMakeLists.txt
```
cmake_minimum_required(VERSION 3.20.0)
find_package(Zephyr REQUIRED HINTS $ENV{ZEPHYR_BASE})

project(ft007th_rx VERSION 1.0.0 LANGUAGES C)

target_sources(app PRIVATE
    src/main.c
    src/ft007th.c
)
```

## prj.conf
```kconfig
# ── USB CDC ACM (JSON output over USB) ────────────────────────────────────────
CONFIG_USB_DEVICE_STACK=y
CONFIG_USB_DEVICE_PRODUCT="FT007TH RF Sensor Bridge"
CONFIG_USB_DEVICE_MANUFACTURER="homehub"
CONFIG_USB_DEVICE_VID=0x2FE3
CONFIG_USB_DEVICE_PID=0x0100
CONFIG_USB_CDC_ACM=y
CONFIG_SERIAL=y
CONFIG_UART_INTERRUPT_DRIVEN=y
CONFIG_UART_LINE_CTRL=y

# ── GPIO (RF RX data pin) ──────────────────────────────────────────────────────
CONFIG_GPIO=y

# ── Floating-point printf (needed for "%.1f" in snprintf) ─────────────────────
CONFIG_FPU=y
CONFIG_FPU_SHARING=y
CONFIG_CBPRINTF_FP_SUPPORT=y

# ── DWT cycle counter (sub-µs GPIO edge timing) ───────────────────────────────
CONFIG_CORTEX_M_DWT=y

# ── Logging ───────────────────────────────────────────────────────────────────
CONFIG_LOG=y
CONFIG_LOG_DEFAULT_LEVEL=3
CONFIG_LOG_BACKEND_UART=y

# ── Stack / heap ──────────────────────────────────────────────────────────────
CONFIG_MAIN_STACK_SIZE=2048
CONFIG_HEAP_MEM_POOL_SIZE=1024
```

## boards/nrf52840dongle_nrf52840.overlay
```dts
/*
 * nRF52840 Dongle (PCA10059) overlay for ft007th-rx.
 *
 * RF receiver DATA pin → TP8 (P0.29) on the bottom of the PCB.
 * This test point requires soldering a thin wire (~28 AWG).
 *
 * Wiring:
 *   Receiver VCC  → VDD pad on Dongle (3.3 V regulator output)
 *   Receiver GND  → GND pad
 *   Receiver DATA → TP8 / P0.29
 *
 * Note: the Dongle is a compact USB stick with no GPIO headers.
 * For easier wiring, prefer connecting the receiver directly to the
 * Raspberry Pi GPIO and using scripts/ft007th_rx.py instead.
 */

/ {
	rf_inputs {
		compatible = "gpio-keys";

		rf_rx: rf_rx_0 {
			gpios = <&gpio0 29 GPIO_ACTIVE_HIGH>;
			label = "RF RX Data (TP8)";
		};
	};

	aliases {
		rf-rx = &rf_rx;
	};
};
```

## src/main.c
```c
/*
 * main.c – FT007TH 433 MHz sensor → USB CDC ACM JSON bridge
 *          for nRF52840 (nRF Connect SDK / Zephyr RTOS)
 *
 * The nRF52840 does NOT have a built-in 433 MHz radio — it needs an external
 * superheterodyne OOK receiver module wired to a GPIO pin.  The module outputs
 * a clean digital signal that this firmware decodes using edge timestamps.
 *
 * Once per sensor transmission (roughly every 60 s) it prints one JSON line
 * to the USB CDC ACM port:
 *   {"model":"Telldus-FT007TH","id":42,"channel":1,
 *    "battery_ok":1,"temperature_C":21.3,"humidity":65}
 *
 * On the Raspberry Pi, set in .env:
 *   SENSOR_SERIAL_PORT=/dev/ttyACM0
 */

#include <zephyr/kernel.h>
#include <zephyr/device.h>
#include <zephyr/drivers/gpio.h>
#include <zephyr/drivers/uart.h>
#include <zephyr/usb/usb_device.h>
#include <zephyr/logging/log.h>
#include <stdio.h>
#include <string.h>

#include "ft007th.h"

LOG_MODULE_REGISTER(ft007th_rx, LOG_LEVEL_INF);

/* ── Devicetree ──────────────────────────────────────────────────────────── */

/* rf-rx alias defined in boards/<board>.overlay */
static const struct gpio_dt_spec rf_rx =
	GPIO_DT_SPEC_GET(DT_ALIAS(rf_rx), gpios);

/* led0 — already defined in the board's base DTS; blinks on valid packet */
static const struct gpio_dt_spec led =
	GPIO_DT_SPEC_GET(DT_ALIAS(led0), gpios);

/* CDC ACM UART — created automatically when CONFIG_USB_CDC_ACM=y */
static const struct device *const cdc_uart =
	DEVICE_DT_GET(DT_NODELABEL(cdc_acm_uart0));

/* ── ISR → main-thread packet slot ──────────────────────────────────────── */

static struct {
	uint64_t      bits;
	volatile bool ready;
} g_pkt;

/* ── GPIO ISR ─────────────────────────────────────────────────────────────── */

static struct gpio_callback rf_cb;

/*
 * Protocol timing (µs):
 *   Sync / idle gap  > 3 500      → reset accumulator
 *   Long gap           1 200–2 800 → bit 1
 *   Short gap            350–1 200 → bit 0
 *
 * Pulses (HIGH) are approximately 500 µs and carry no information; only the
 * gap (LOW) duration between pulses encodes the bit value.
 */
static void rf_isr(const struct device *dev,
		   struct gpio_callback *cb,
		   uint32_t pins)
{
	static uint32_t fall_cy;   /* cycle count at last falling edge */
	static uint64_t bit_buf;
	static uint8_t  bit_cnt;

	const uint32_t now   = k_cycle_get_32();
	const int      level = gpio_pin_get_dt(&rf_rx);

	if (level <= 0) {
		/* Falling edge — record gap start */
		fall_cy = now;
		return;
	}

	/* Rising edge — gap just ended; measure its duration */
	const uint32_t gap_us = k_cyc_to_us_near32(now - fall_cy);

	if (gap_us > 3500U) {
		bit_buf = 0U;
		bit_cnt = 0U;
		return;
	}

	uint8_t new_bit;

	if (gap_us >= 1200U && gap_us < 2800U) {
		new_bit = 1U;
	} else if (gap_us >= 350U && gap_us < 1200U) {
		new_bit = 0U;
	} else {
		return; /* out-of-range — noise, ignore */
	}

	bit_buf = (bit_buf << 1) | new_bit;

	if (++bit_cnt == 36U) {
		if (!g_pkt.ready) {
			g_pkt.bits  = bit_buf;
			g_pkt.ready = true;
		}
		bit_buf = 0U;
		bit_cnt = 0U;
	}
}

/* ── CDC ACM helpers ─────────────────────────────────────────────────────── */

/** Returns true when a host has opened the serial port (DTR asserted). */
static bool cdc_open(void)
{
#ifdef CONFIG_UART_LINE_CTRL
	uint32_t dtr = 0U;

	(void)uart_line_ctrl_get(cdc_uart, UART_LINE_CTRL_DTR, &dtr);
	return dtr != 0U;
#else
	return true;
#endif
}

static void cdc_puts(const char *s)
{
	for (; *s != '\0'; ++s) {
		uart_poll_out(cdc_uart, (unsigned char)*s);
	}
}

/* ── Entry point ─────────────────────────────────────────────────────────── */

int main(void)
{
	int ret;

	/* Start USB — must happen before any other USB call */
	ret = usb_enable(NULL);
	if (ret != 0) {
		LOG_ERR("usb_enable failed: %d", ret);
		return ret;
	}

	/* Status LED (optional — keep going if the board lacks one) */
	if (device_is_ready(led.port)) {
		gpio_pin_configure_dt(&led, GPIO_OUTPUT_INACTIVE);
	}

	/* RF RX GPIO */
	if (!device_is_ready(rf_rx.port)) {
		LOG_ERR("RF RX GPIO port not ready");
		return -ENODEV;
	}

	ret = gpio_pin_configure_dt(&rf_rx, GPIO_INPUT);
	if (ret < 0) {
		LOG_ERR("gpio_pin_configure_dt: %d", ret);
		return ret;
	}

	ret = gpio_pin_interrupt_configure_dt(&rf_rx, GPIO_INT_EDGE_BOTH);
	if (ret < 0) {
		LOG_ERR("gpio_pin_interrupt_configure_dt: %d", ret);
		return ret;
	}

	gpio_init_callback(&rf_cb, rf_isr, BIT(rf_rx.pin));
	gpio_add_callback(rf_rx.port, &rf_cb);

	LOG_INF("FT007TH receiver ready — listening for 433 MHz packets");

	char json[160];

	for (;;) {
		if (g_pkt.ready) {
			const uint64_t        bits = g_pkt.bits;
			const ft007th_reading_t r  = ft007th_decode(bits);

			g_pkt.ready = false;

			if (r.valid && cdc_open()) {
				snprintf(json, sizeof(json),
					 "{\"model\":\"Telldus-FT007TH\","
					 "\"id\":%u,"
					 "\"channel\":%u,"
					 "\"battery_ok\":%u,"
					 "\"temperature_C\":%.1f,"
					 "\"humidity\":%u}\n",
					 (unsigned)r.device_id,
					 (unsigned)r.channel,
					 (unsigned)r.battery_ok,
					 (double)r.temperature_c,
					 (unsigned)r.humidity);
				cdc_puts(json);

				/* Brief LED blink to confirm reception */
				if (device_is_ready(led.port)) {
					gpio_pin_set_dt(&led, 1);
					k_sleep(K_MSEC(100));
					gpio_pin_set_dt(&led, 0);
				}
			}
		}

		k_sleep(K_MSEC(10));
	}

	return 0;
}
```

## src/ft007th.c
```c
/**
 * @file ft007th.c
 * @brief Telldus FT007TH 36-bit packet decoder.
 *
 * Packet layout (MSB = bit 35, 9 nibbles total):
 *
 *   [35:33]  channel    3 bits  (0 = CH1 … 7 = CH8)
 *   [32]     battery    1 bit   (1 = OK)
 *   [31:24]  device ID  8 bits  (random per sensor)
 *   [23:12]  temp raw  12 bits  (unsigned; temp_C = (raw − 400) / 10.0)
 *   [11:4]   humidity   8 bits  (%RH)
 *   [3:0]    checksum   4 bits  (XOR of all nine nibbles = 0 when valid)
 *
 * Source: community reverse-engineering of Telldus FT007TH / Proove AB 313160,
 * validated against rtl_433.
 */
#include "ft007th.h"

static bool checksum_ok(uint64_t bits)
{
	uint8_t xor = 0U;

	/* XOR nine 4-bit nibbles, starting from the MSB nibble [35:32] */
	for (int shift = 32; shift >= 0; shift -= 4) {
		xor ^= (uint8_t)((bits >> shift) & 0xFU);
	}
	return xor == 0U;
}

ft007th_reading_t ft007th_decode(uint64_t bits)
{
	ft007th_reading_t r = {0};

	r.valid         = checksum_ok(bits);
	r.channel       = (uint8_t)((bits >> 33) & 0x7U) + 1U;
	r.battery_ok    = (bool)((bits >> 32) & 0x1U);
	r.device_id     = (uint8_t)((bits >> 24) & 0xFFU);

	uint16_t temp_raw = (uint16_t)((bits >> 12) & 0xFFFU);
	r.temperature_c   = ((float)temp_raw - 400.0f) / 10.0f;

	r.humidity      = (uint8_t)((bits >> 4) & 0xFFU);

	return r;
}
```

## src/ft007th.h
```c
/**
 * @file ft007th.h
 * @brief Decoder for the Telldus FT007TH / Proove AB 313160
 *        433 MHz thermo-hygrometer (OOK PWM, 36 bits).
 */
#pragma once

#include <stdbool.h>
#include <stdint.h>

/** Decoded reading from one FT007TH packet. */
typedef struct {
	/** Random 8-bit ID, stable until battery swap. */
	uint8_t  device_id;
	/** Channel 1–8 selected by the DIP switches on the sensor back. */
	uint8_t  channel;
	/** 1 = battery OK, 0 = replace batteries. */
	bool     battery_ok;
	/** Temperature in degrees Celsius (resolution 0.1 °C). */
	float    temperature_c;
	/** Relative humidity 0–99 %RH. */
	uint8_t  humidity;
	/** false when the 4-bit XOR checksum does not match. */
	bool     valid;
} ft007th_reading_t;

/**
 * @brief Decode a 36-bit FT007TH OOK packet.
 *
 * @param bits  36 bits of data, MSB at bit 35 (bit 0 = checksum LSB).
 * @return Decoded reading; inspect .valid before using any field.
 */
ft007th_reading_t ft007th_decode(uint64_t bits);
```
